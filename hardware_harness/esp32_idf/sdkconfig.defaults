## hardware_harness/esp32_idf/sdkconfig.defaults
```kconfig
CONFIG_ESP_DEFAULT_CPU_FREQ_MHZ_240=y
CONFIG_ESP_MAIN_TASK_STACK_SIZE=32768
CONFIG_ESP_TASK_WDT_INIT=n
CONFIG_ESP_INT_WDT=n
CONFIG_COMPILER_OPTIMIZATION_PERF=y
CONFIG_FREERTOS_HZ=1000
```
